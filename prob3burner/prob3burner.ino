#include <avr/pgmspace.h>
#include <Wire.h>
#include <LiquidCrystal_I2C.h>

#define disk1 0x50    //Address of 24LC256 eeprom chip


LiquidCrystal_I2C lcd(0x27, 2, 1, 0, 4, 5, 6, 7, 3, POSITIVE);  // Set the LCD I2C address


//const char voice_name[] PROGMEM  = {"PropB3          Jimmy Smith     Reggae          Full n' Sweet   Full n' high    Plaintive balladGreg Rolie      Gregg Allman 1  Gregg Allman 2  Gregg Allman 3  Paul Shaffer    Errol Garner    Jazz            Silky sound     Waa-waa         Fatt sound      Blues           Soul Sacrifice  Evil Ways       It's Only Love  I'm So Excited  Late Show inci  Grn Onions C1   Grn Onions C2   W S of P        Roll With It    Dont Lve Me Nw  Bro' Jack style Nice strings    16 chords       Power chords    Shouting chords Full Shout      Gud ole' gospel Melvin Crispel  Meditation      Annointed Jazz  Grosse Flute 8  Aeoline         Bass Horn       Basso64 8       Basso64 16      Bombarde 16     Bourdon 16      Contra Celeste16Octave Celeste 4Viol Celeste 8  Cello 8         Clarion 4       Clarinet        Clarinet        Clarinet 8      Clarinet 8      Clarinet 8 choirClarinet 16     Cornet          Diapason 8      Diapason 16     Open Diapason 8 Swell Diapas64  Dulciana 8      English Horn 8  English Horn 16 Contra Fagotte16Flugelhorn      Flute d Amour   Hohl Flute 8    Stopped Flute   Harmonic Flute 4Flute 4         Concert Flute 8 Concert Flute 8 16 Concert FluteFrench Horn     Gamba           Gedeckt 8 swell Gedeckt 8 choir Krumet 8        Oboe Horn 4     Oboe Horn 8     Oboe            Oboe Horn 8     Oboe Horn 16    Octave4(theater)Octave 4 (great)Octave 2        Ophicleide 16   Picolo2(theater)Piccolo 2 swell Piccolo 4       Principal 2     Principal 4     Principal 8     Quint 1 1/3     Quintadena 16   Salicional thtreSalicional8swellSaxophone 8     Saxophone 16    Siffloete 1     Novel Solo 8    Theater Solo 16 Tibia 2         Tibia 8         Tibia 8         16 Tibia        16 Tibia        Tibia 16        Tibia Clausa    Trumpet         Trmpet 8 thetr  Trumpet 8 swell Tuba 8          Twelfth         Viol 4          Viold Orchestre8Violin          Vibraharp 8     Vox Celeste 8   Vox Humana 4    Vox Humana 8    Vox Humana 16   Unda Maris 8    Flageolet 2     Nazard 2 2/3    Tierce 1 3/5    Tromba 8        Gemshorn 8      GeigenDiapason 8Octave Geigen 4 Traverse Flute 4FlautoMirabilis8Flute Ouverte 8 Leiblichgedeckt8Clarabelle 8    Spitzflote 8    Waldflote 8     Blockflote 4    Suabe flute 4   Cromhorne       Clarinet        Oboe Horn       Tuba 16         Piano           Contra Viol 16  Toccata and Fuge16 Strings      FullThtrbrass16 Great no reeds  Reed Chorus     Brass Chorus    Woodwnd Chrs    Woodwind Ensbl  String Chorus   String Chorus   String Ensemble Dipsn Gamba&Flt Tibias 8 and 2  Full Tibias 16  Full Swell      Flutes 8 and 4  Flute and StringVox 8 & Tibia 4 Full Accomp. 8  Mixture 3 ranks Mixture 4 ranks Full Great      Full Great w 16 Full Organ Cpld String Accomp. 8Solo Strings 4  Solo Strings 8  Solo Strings 16 Full Accmpnt 16 Vox 8 & Tibia 4  "};
const char voice_name[] PROGMEM  = {"PropB3          Greg Rolie      Gregg Allman 1  Gregg Allman 2  Gregg Allman 3  Paul Shaffer    Errol Garner    Jimmy Smith     Reggae          Full n' Sweet   Full n' high    Plaintive balladJazz            Silky sound     Waa-waa         Fatt sound      Blues           Soul Sacrifice  Evil Ways       It's Only Love  I'm So Excited  Late Show inci  Grn Onions C1   Grn Onions C2   W S of P        Roll With It    Dont Lve Me Nw  Bro' Jack style Nice strings    16 chords       Power chords    Shouting chords Full Shout      Gud ole' gospel Melvin Crispel  Meditation      Annointed Jazz  Grosse Flute 8  Aeoline         Bass Horn       Basso64 8       Basso64 16      Bombarde 16     Bourdon 16      Contra Celeste16Octave Celeste 4Viol Celeste 8  Cello 8         Clarion 4       Clarinet        Clarinet        Clarinet 8      Clarinet 8      Clarinet8(choir)Clarinet 16     Cornet          Diapason 8      Diapason 16     Open Diapason 8 Swell Diapas64  Dulciana 8      English Horn 8  English Horn 16 Contra Fagotte16Flugelhorn      Flute d Amour   Hohl Flute 8    Stopped Flute   Harmonic Flute 4Flute 4         Concert Flute 8 Concert Flute 8 16 Concert FluteFrench Horn     Gamba           Gedeckt 8(swell)Gedeckt 8(choir)Krumet 8        Oboe Horn 4     Oboe Horn 8     Oboe            Oboe Horn 8     Oboe Horn 16    Octave4(theater)Octave 4 (great)Octave 2        Ophicleide 16   Picolo2(theater)Piccolo 2(swell)Piccolo 4       Principal 2     Principal 4     Principal 8     Quint 1 1/3     Quintadena 16   Salicional thtreSalicional8swellSaxophone 8     Saxophone 16    Siffloete 1     Novel Solo 8    Theater Solo 16 Tibia 2         Tibia 8         Tibia 8         16 Tibia        16 Tibia        Tibia 16        Tibia Clausa    Trumpet         Trmpet 8 thetr  Trumpet 8 swell Tuba 8          Twelfth         Viol 4          Viold Orchestre8Violin          Vibraharp 8     Vox Celeste 8   Vox Humana 4    Vox Humana 8    Vox Humana 16   Unda Maris 8    Flageolet 2     Nazard 2 2/3    Tierce 1 3/5    Tromba 8        Gemshorn 8      GeigenDiapason 8Octave Geigen 4 Traverse Flute 4FlautoMirabilis8Flute Ouverte 8 Leiblichgedeckt8Clarabelle 8    Spitzflote 8    Waldflote 8     Blockflote 4    Suabe flute 4   Cromhorne       Clarinet        Oboe Horn       Tuba 16         Piano           Contra Viol 16  Toccata and Fuge16 Strings      FullThtrbrass 16Great, no reeds Reed Chorus     Brass Chorus    Woodwnd Chrs    Woodwind Ensbl  String Chorus   String Chorus   String Ensemble Dipson,Gmb & fltTibias 8 and 2  Full Tibias 16  Full Swell      Flutes 8 and 4  Flute and StringVox 8 & Tibia 4 Full Accomp. 8  Mixture 3 ranks Mixture 4 ranks Full Great      Full Great w 16 Full Organ Cpld String Accomp. 8Solo Strings 4  Solo Strings 8  Solo Strings 16 Full Accmpnt 16 Vox 8 & Tibia 4  "};  

//const PROGMEM  int  voice_data1[] = {0,0,0,0,0,0,0,0,0,0,0,0,0,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0,}; 
//const PROGMEM  int  voice_data1[] =   {0,0,0,0,0,0,0,0,0,0,0,0,0,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0,};
const PROGMEM  int  voice_data1[] =   {0,0,0,0,0,0,0,0,0,0,0,0,0,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0,};

unsigned int displayInt;
int k=0;    // counter variable
char myChar;
int vc=0;
int z=0;
int vd;

void setup() {
unsigned int address = 0;

   lcd.begin(16, 2);
   lcd.backlight();

  Serial.begin(115200);
  while (!Serial);
  lcd.setCursor(0, 0); //Start at character 0 on line 0
  lcd.print("  PropB3 Buddy  ");
  delay(500);
  lcd.setCursor(0, 1);
  lcd.print("  Voice Burner  ");
  delay(1000);
  lcd.setCursor(0, 0); //Start at character 0 on line 0
  lcd.print("Voice: ");
  delay(500);
  

  
   // read back a char
   for (vc=0; vc < 175; vc++)
{
   Serial.print("Burning Voice number ");
   lcd.setCursor(0, 0); //Start at character 0 on line 0
   lcd.print("                ");
   lcd.setCursor(0, 0); //Start at character 0 on line 0
   lcd.print("Voice: ");
   lcd.print((vc+1));
   Serial.print((vc+1));
   Serial.print("  ");
   lcd.setCursor(0, 1);
   lcd.print("                ");
   lcd.setCursor(0, 1);

   delay(100);

   for (k = (vc*16); k < ((vc*16)+16); k++)
   {

     myChar =  pgm_read_byte_near(voice_name + k);

     lcd.print(myChar);
     Serial.print(myChar);
     Serial.print(address);
     Serial.print(" ");
     writeEEPROM(disk1, address, myChar);
   Serial.print(" ");
   address++;
   Serial.print(readEEPROM(disk1, address), DEC);
   }
   delay(500);
   Serial.print(" ");
   address++;
   // read back a 2-byte int
   for (z = (vc*15); z < ((vc*15)+15); z++)
   {
   displayInt = pgm_read_word_near(voice_data1 + z);
   address++;
   Serial.print(displayInt,HEX);
   Serial.print(",");
   Serial.print(address);
   Serial.print(" ");
  writeEEPROM(disk1, address, displayInt);
   }

   Serial.println();
}

   lcd.setCursor(0, 0);
   lcd.print("                ");
   lcd.setCursor(0, 1);
   lcd.print("                ");
   lcd.setCursor(0, 0);
   lcd.print("All Finished ;-)");

}

void loop() {
   // put your main code here, to run repeatedly:

}

void writeEEPROM(int deviceaddress, unsigned int eeaddress, byte myChar ) 
{
  Wire.beginTransmission(deviceaddress);
  Wire.write((int)(eeaddress >> 8));   // MSB
  Wire.write((int)(eeaddress & 0xFF)); // LSB
  Wire.write(myChar);
  Wire.endTransmission();
 
  delay(5);
}

byte readEEPROM(int deviceaddress, unsigned int eeaddress ) 
{
  byte rdata = 0xFF;
 
  Wire.beginTransmission(deviceaddress);
  Wire.write((int)(eeaddress >> 8));   // MSB
  Wire.write((int)(eeaddress & 0xFF)); // LSB
  Wire.endTransmission();
 
  Wire.requestFrom(deviceaddress,1);
 
  if (Wire.available()) rdata = Wire.read();
 
  return rdata;
}

